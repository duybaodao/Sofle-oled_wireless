## dts/bindings/behaviors/zmk,behavior-bt-morph.yaml
```yaml
description: Bluetooth Morph Behavior

compatible: "zmk,behavior-bt-morph"

include: two_param.yaml

properties:
  bindings:
    type: phandle-array
    required: true
```
